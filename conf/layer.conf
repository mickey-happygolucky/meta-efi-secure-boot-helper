## conf/layer.conf
```bitbake
# We have a conf and classes directory, add to BBPATH
BBPATH .= ":${LAYERDIR}"

# We have recipes-* directories, add to BBFILES
BBFILES += "${LAYERDIR}/recipes-*/*/*.bb \
            ${LAYERDIR}/recipes-*/*/*.bbappend"

BBFILE_COLLECTIONS += "meta-efi-secure-boot-helper"
BBFILE_PATTERN_meta-efi-secure-boot-helper = "^${LAYERDIR}/"
BBFILE_PRIORITY_meta-efi-secure-boot-helper = "20"

LAYERDEPENDS_meta-efi-secure-boot-helper = "core"
LAYERSERIES_COMPAT_meta-efi-secure-boot-helper = "honister kirkstone langdale"
```
